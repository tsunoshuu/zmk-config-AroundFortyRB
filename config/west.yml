## config/west.yml
```yaml
manifest:
  remotes:
    - name: zmkfirmware
      url-base: https://github.com/zmkfirmware
    - name: razilyis
      url-base: https://github.com/razilyis
    - name: caksoylar
      url-base: https://github.com/caksoylar
    - name: tsunoshuu
      url-base: https://github.com/tsunoshuu
  projects:
    - name: zmk
      remote: zmkfirmware
      revision: v0.3.0
      import: app/west.yml
    - name: zmk-pmw3610-driver
      remote: razilyis
      # Dev-v0.3_inertial-scroll, inspected 2026-09-28.
      revision: d06f92cabfce392cf472eea05d722bc94620700e
    - name: zmk-rgbled-widget
      remote: caksoylar
      # This module's release must match ZMK, not its moving main branch.
      revision: v0.3
    - name: zmk-naginata
      remote: tsunoshuu
      revision: original
  self:
    path: config
```
